## config/west.yml
```yaml
manifest:
  remotes:
    - name: zmkfirmware
      url-base: https://github.com/zmkfirmware
    - name: vzhny
      url-base: https://github.com/vzhny
  projects:
    - name: zmk
      remote: zmkfirmware
      revision: v0.3.0
      import: app/west.yml
    - name: zmk-bootloader-hold
      remote: vzhny
      revision: v1.1.0
  self:
    path: config
```
