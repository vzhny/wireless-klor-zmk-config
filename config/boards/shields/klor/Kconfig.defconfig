## config/boards/shields/klor/Kconfig.defconfig
```kconfig
if SHIELD_KLOR_LEFT

    config ZMK_KEYBOARD_NAME
        default "KLOR"

    config ZMK_SPLIT_ROLE_CENTRAL
        default y

endif # LEFT



if SHIELD_KLOR_LEFT || SHIELD_KLOR_RIGHT

    config ZMK_SPLIT
        default y


if ZMK_DISPLAY

    config I2C
        default y

    config SSD1306
        default y

    config SSD1306_REVERSE_MODE
        bool
        default y

    # Custom connection-driven blanking (klor_display_power.c) replaces this;
    # leaving it enabled would un-blank the panel on the next keypress even
    # while klor_display_power still considers the half connected.
    config ZMK_DISPLAY_BLANK_ON_IDLE
        default n

endif # ZMK_DISPLAY

config KLOR_DISPLAY_AUTO_OFF
    bool "Turn KLOR OLEDs off once connected"
    depends on ZMK_DISPLAY
    default y
    help
      Blanks each half's OLED once it has a live connection (BT profile +
      peripheral link on the left, peripheral link on the right), and
      un-blanks it again if that connection drops or a new BT profile is
      selected. These are bare SSD1306 panels, not nice!view modules, and
      haven't been power-profiled on this PCB -- this treats them as a
      connect/reconnect sanity check rather than an always-on status
      display. Say n to keep both OLEDs always on instead.



if LVGL

    config LV_Z_VDB_SIZE
        default 64

    config LV_DPI_DEF
        default 148

    config LV_Z_BITS_PER_PIXEL
        default 1

    choice LV_COLOR_DEPTH
        default LV_COLOR_DEPTH_1
    endchoice

endif # LVGL


endif # LEFT RIGHT
```
